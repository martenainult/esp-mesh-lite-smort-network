## sdkconfig.defaults
```kconfig
# Override some defaults in mesh application project.

#
# Serial flasher config
#
CONFIG_ESPTOOLPY_FLASHSIZE_4MB=y

#
# FreeRTOS
#
CONFIG_FREERTOS_UNICORE=y
CONFIG_FREERTOS_HZ=1000
CONFIG_FREERTOS_TIMER_TASK_STACK_DEPTH=3072
CONFIG_FREERTOS_USE_TRACE_FACILITY=y
CONFIG_FREERTOS_USE_STATS_FORMATTING_FUNCTIONS=y
CONFIG_FREERTOS_VTASKLIST_INCLUDE_COREID=y
CONFIG_FREERTOS_GENERATE_RUN_TIME_STATS=y

#
# ESP32-specific
#
CONFIG_ESP_TASK_WDT_PANIC=y
CONFIG_ESP_TASK_WDT_TIMEOUT_S=10
CONFIG_ESP32_ENABLE_COREDUMP=y
CONFIG_ESP_TIMER_TASK_STACK_SIZE=4096 // 

CONFIG_ESP_DEFAULT_CPU_FREQ_MHZ_240=y
CONFIG_ESP_DEFAULT_CPU_FREQ_MHZ=240
CONFIG_BUTTON_SHORT_PRESS_TIME_MS=50


#
# Wi-Fi
#
# https://developer.nordicsemi.com/nRF_Connect_SDK/doc/1.9.2-dev1/kconfig/CONFIG_ESP32_WIFI_AMPDU_RX_ENABLED.html
CONFIG_ESP32_WIFI_AMPDU_TX_ENABLED=
CONFIG_ESP32_WIFI_AMPDU_RX_ENABLED=

# LWIP
CONFIG_LWIP_IP_FORWARD=y
CONFIG_LWIP_IPV4_NAPT=y
CONFIG_MESH_LITE_ENABLE=y
CONFIG_MESH_LITE_NODE_INFO_REPORT=y

CONFIG_BRIDGE_SOFTAP_SSID_END_WITH_THE_MAC=y

# upgrades

CONFIG_ESPTOOLPY_FLASHFREQ_80M=y
CONFIG_ESPTOOLPY_FLASHFREQ="80m"

CONFIG_APPTRACE_DEST_UART0=
CONFIG_ETH_USE_SPI_ETHERNET=

CONFIG_ESP_HTTP_CLIENT_ENABLE_HTTPS=
CONFIG_XTAL_FREQ_40=y
CONFIG_XTAL_FREQ_AUTO=
CONFIG_XTAL_FREQ=40

CONFIG_LWIP_TCPIP_TASK_PRIO=3

CONFIG_LWIP_TCP_SND_BUF_DEFAULT=14360
CONFIG_LWIP_TCP_WND_DEFAULT=14360
CONFIG_LWIP_TCP_RECVMBOX_SIZE=12

CONFIG_BRIDGE_SOFTAP_MAX_CONNECT_NUMBER=6
CONFIG_JOIN_MESH_IGNORE_ROUTER_STATUS=y

CONFIG_TCP_SND_BUF_DEFAULT=14360
CONFIG_TCP_WND_DEFAULT=14360
CONFIG_TCP_RECVMBOX_SIZE=12

CONFIG_ESP_WIFI_SLP_BEACON_LOST_OPT=
```
